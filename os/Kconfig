## os/Kconfig
```kconfig
mainmenu "Smartwatch OS Configuration"

source "drivers/Kconfig"

source "arch/Kconfig"

config STM32WB55
    bool "Enable STM32WB55"
    help
        Enables the STM32WB55 MCU

config LINKER_SCRIPT
    string "linker script name"
    help
        Sets the linker script to link the object files with
```

## os/arch/Kconfig
```kconfig
config CORTEX_M
    bool "Enable Cortex M"
    help
        Enables ARM Cortex M
```

## os/configs/stm32wb55nucleo_defconfig
```kconfig
CONFIG_STM32WB55=y
CONFIG_CORTEX_M=y
CONFIG_RCC_PLLM=20
CONFIG_RCC_PLLN=20
CONFIG_RCC_PLLP=20
CONFIG_RCC_PLLQ=20
CONFIG_LINKER_SCRIPT="stm32wb55nucleo_flash_cm4.ld"
```

## os/drivers/Kconfig
```kconfig
menu "Driver configuration"

config ST_RCC
        bool "Enables the ST RCC Driver"
        help
          Enables the ST RCC Driver

config RCC_PLLM
        int "Sets PLLM"
        depends on ST_RCC
        help
          TODO: add the pll clock config

config RCC_PLLN
        int "Sets PLLN"
        depends on ST_RCC
        help
          TODO: add the pll clock config

config RCC_PLLP
        int "Sets PLLP"
        depends on ST_RCC
        help
          TODO: add the pll clock config

config RCC_PLLQ
        int "Sets PLLQ"
        depends on ST_RCC
        help
          TODO: add the pll clock config

endmenu
```
